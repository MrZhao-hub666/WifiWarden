## esp32s3/wifiwarden/components/cjson/Kconfig
```kconfig
menu "cJSON"

config ESP_COMPONENT_CJSON
    bool "cJSON component"
    default y

endmenu
```

## esp32s3/wifiwarden/components/st7789/Kconfig
```kconfig
menu "ST7789 Display"

config ESP_COMPONENT_ST7789
    bool "ST7789 display driver"
    default y

endmenu
```

## esp32s3/wifiwarden/main/Kconfig.projbuild
```kconfig
menu "WiFiWardern Scanner Configuration"

    menu "Scanner WiFi Settings"
        config SCANNER_AP_SSID
            string "AP SSID to connect"
            default "WifiWarden"
            help
                SSID of the AP board's WiFi hotspot.
                The scanner board connects to this WiFi to enter the AP's LAN.

        config SCANNER_AP_PASSWORD
            string "AP Password"
            default "CHANGE_ME"
            help
                Password for the AP board's WiFi hotspot.
    endmenu

    menu "MQTT Cloud Settings"
        config MQTT_BROKER_URI
            string "MQTT Broker URI"
            default "mqtt://YOUR_SERVER_IP:1883"
            help
                MQTT broker URI for cloud communication.

        config MQTT_USERNAME
            string "MQTT Username"
            default "wifiwarden"
            help
                MQTT broker authentication username.

        config MQTT_PASSWORD
            string "MQTT Password"
            default "CHANGE_ME"
            help
                MQTT broker authentication password.

        config MQTT_PUBLISH_INTERVAL
            int "Data Publish Interval (seconds)"
            default 30
            range 10 300
            help
                Interval between periodic data uploads to cloud.
    endmenu

    menu "Port Scan Settings"
        config PORT_SCAN_INTERVAL
            int "Port Scan Interval (seconds)"
            default 120
            range 30 600
            help
                Interval between periodic network port scans.
    endmenu

    menu "Deauth Detection Settings"
        config DEAUTH_THRESHOLD
            int "Deauth Detection Threshold"
            default 3
            range 1 20
            help
                Number of Deauth frames within the 5-second detection window
                required to trigger a Deauth attack alert.
    endmenu

    menu "Feature Toggles"
        config HONEYPOT_ENABLED
            bool "Enable Honeypot SSID"
            default false
            help
                Enable fake SSID broadcasting for honeypot functionality.

        config BEEPER_ENABLED
            bool "Enable Beeper"
            default true
            help
                Enable buzzer for security alerts.
    endmenu

endmenu
```

## esp32s3/wifiwarden/sdkconfig.defaults
```kconfig
# ESP-IDF Configuration for WiFiWarden ESP32-S3 Scanner Board
# ⚠️ 请根据您的实际环境修改下面的配置 ⚠️

# Flash Configuration
CONFIG_ESPTOOLPY_FLASHSIZE_4MB=y
CONFIG_ESPTOOLPY_FLASHFREQ_80M=y
CONFIG_PARTITION_TABLE_SINGLE_APP_LARGE=y

# Scanner WiFi Settings — 连接到AP板的WifiWarden热点
CONFIG_SCANNER_AP_SSID="WifiWarden"
CONFIG_SCANNER_AP_PASSWORD="YOUR_AP_PASSWORD"

# MQTT Cloud Settings — 修改为您的服务器地址和凭据
CONFIG_MQTT_BROKER_URI="mqtt://YOUR_SERVER_IP:1883"
CONFIG_MQTT_USERNAME="YOUR_MQTT_USERNAME"
CONFIG_MQTT_PASSWORD="YOUR_MQTT_PASSWORD"
CONFIG_MQTT_PUBLISH_INTERVAL=10

# Port Scan Settings
CONFIG_PORT_SCAN_INTERVAL=10

# Deauth Detection Settings
CONFIG_DEAUTH_THRESHOLD=3

# Feature Toggles
CONFIG_HONEYPOT_ENABLED=n
CONFIG_BEEPER_ENABLED=y

# Compiler: -O2 avoids GCC 13.2 ICE on esp_lcd_panel_rgb.c with -Og
CONFIG_COMPILER_OPTIMIZATION_PERF=y

# SPI Master ISR in IRAM (prevent screen corruption from WiFi interrupt)
CONFIG_SPI_MASTER_ISR_IN_IRAM=y
```

## esp32s3/wifiwarden_ap/main/Kconfig.projbuild
```kconfig
menu "WiFiWardern AP Settings"

    menu "WiFi AP Settings"
        config AP_SSID
            string "AP SSID"
            default "WifiWarden"
            help
                SSID of the WiFi AP broadcast by this device.

        config AP_PASSWORD
            string "AP Password"
            default "CHANGE_ME"
            help
                Password for the WiFi AP.
    endmenu

    menu "WiFi STA Settings"
        config WIFI_SSID
            string "WiFi SSID"
            default "YOUR_WIFI_SSID"
            help
                SSID of the upstream WiFi network to connect to.

        config WIFI_PASSWORD
            string "WiFi Password"
            default "YOUR_WIFI_PASSWORD"
            help
                Password for the upstream WiFi network.
    endmenu

    menu "NAT Settings"
        config ENABLE_NAPT
            bool "Enable NAPT (Network Address Port Translation)"
            default y
            help
                Enable NAPT to allow AP clients to access internet via STA connection.
                This is required for the WiFi bridge functionality.
    endmenu

    menu "Device Info"
        config DEVICE_NAME
            string "Device Name"
            default "WiFiWardern-AP"
            help
                Human-readable device name.

        config DEVICE_TYPE
            string "Device Type"
            default "ESP32S3-AP"
            help
                Device type identifier.
    endmenu

endmenu
```
